## drivers/video/fbdev/exynos/decon_7570/panels/Kconfig
```kconfig
config EXYNOS_DECON_LCD
	depends on EXYNOS_DECON_7570
	bool "Select LCD panel driver"

config EXYNOS_DECON_LCD_SYSFS
	depends on EXYNOS_DECON_LCD
	tristate "Support LCD SYSFS"
	default y

config PANEL_AID_DIMMING
	depends on EXYNOS_DECON_LCD
	tristate "Support AID Dimming"
	default n

config EXYNOS_DECON_MDNIE_LITE
	depends on EXYNOS_DECON_LCD
	tristate "Support MDNIE LITE"
	default n

config PANEL_S6E8AA5X01
	depends on EXYNOS_DECON_LCD
	bool "S6E8AA5X01 AMOLE HD LCD driver(720 x 1280)"

config PANEL_TD4100
	depends on EXYNOS_DECON_LCD
	bool "TD4100 TFT INCELL HD LCD driver(720 x 1280)"
```
